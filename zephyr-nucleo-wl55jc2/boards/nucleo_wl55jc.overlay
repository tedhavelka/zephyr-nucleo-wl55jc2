/*
 *  nucleo_wl55jc.overlay, to support bootloader development work
 */


/ {
        aliases {
                ledblue = &blue_led_1;
                led1 = &blue_led_1;
        };
};


/*
 *  References:
 *  (1) [zephyr_workspace]/zephyr/dts/arm/st/wl/stm32wl.dtsi
 *  (2) [zephyr_workspace]/zephyr/boards/arm/nucleo_wl55jc/nucleo_wl55jc.dts
 *  (3) [zephyr_workspace]/modules/hal/stm32/dts/st/wl/stm32wl55jcix-pinctrl.dtsi
 */

&usart1 {
        pinctrl-0 = <&usart1_tx_pa9 &usart1_rx_pa10>;
        pinctrl-names = "default";
        current-speed = <115200>;
        status = "okay";
};

